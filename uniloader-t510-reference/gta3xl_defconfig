## uniloader-t510-reference/gta3xl_defconfig
```kconfig
CONFIG_POSITION_INDEPENDENT=y
LINUX_KRNL_HEADER_IMG=y
# CONFIG_COMPRESS_GZIP is not set
CONFIG_EXYNOS_7885=y
CONFIG_SAMSUNG_GTA3XL=y
CONFIG_TEXT_BASE=0x87000000
CONFIG_PAYLOAD_ENTRY=0x90000000
CONFIG_RAMDISK_ENTRY=0x84000000
```
